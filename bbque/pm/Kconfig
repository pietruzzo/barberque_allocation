## bbque/pm/Kconfig
```kconfig
config BBQUE_PM
  bool "Enable Power Management support"
  default n
  ---help---
  Build the BarbequeRTRM with support for Power Management (PM).
  When compiled with this option turned on, all the PM management
  facilities could be selectively enabled or disabled. Indeed, each
  module could provide PM related supports, e.g. the optimization
  policy could optimize for power budgeting or the GPU could expose
  a power and thermal monitor.

  If unsure say no, this will disable all the PM related features.

config  BBQUE_PM_BATTERY
  bool "Battery management"
  depends on BBQUE_PM
  default n
  ---help---
  Enable the interface with the system battery, if available.

config BBQUE_WM
  bool "Enable periodic Power Monitoring"
  depends on BBQUE_PM
  default y
  ---help---
  Specify the default value in milliseconds of a period of power monitoring.

config  BBQUE_PM_CPU
  bool "CPU(s) Power and Thermal monitoring"
  depends on BBQUE_PM
  default n
  ---help---
  Enable the support for run-time monitoring of the CPU(s) power and thermal status.

config  BBQUE_PM_AMD
  bool "AMD GPU(s) Power and Thermal monitoring"
  depends on BBQUE_PM
  depends on BBQUE_OPENCL
  depends on !TARGET_LINUX_ARM
  default n
  ---help---
  Enable the support for run-time monitoring of the AMD GPU(s) power and thermal status.

config  BBQUE_PM_GPU_ARM_MALI
  bool "ARM Mali GPU Power and Thermal monitoring"
  depends on BBQUE_PM
  depends on BBQUE_OPENCL
  depends on TARGET_LINUX_ARM
  default n
  ---help---
  Enable the support for run-time monitoring of the GPU ARM Mali series.
```

## bbque/tg/Kconfig
```kconfig
config BBQUE_APP_TG_PATH
  string "Serial files root directory"
  default "/tmp/"
  ---help---
  In case of programming model based on the construction of task-graphs, this
  option specifies the path where to store and retrieve the task-graph in a
  serialization file form. To the sake of performance, we recommend to use a
  path related to a memory mapped file-system (e.g., tmpFs).

config BBQUE_APP_TG_TASKS_MAX_NUM
  int "Maximum number of tasks"
  default 32
  ---help---
  The maximum number of tasks that can be included in a task-graph.
```

## mpi/Kconfig
```kconfig
config BBQUE_MPI
  bool "OpenMPI support"
#  depends on EXTERNAL_OPENMPI
  select CONTRIBS
  default n
  ---help---

  Enable the support to MPI applications.
  
  Build the custom 'bbque-mpirun' command to use for the runtime management of
  MPI applications.
  
```

## plugins/agent_proxy/Kconfig
```kconfig
choice
  prompt "Agent Proxy plugin"
  depends on BBQUE_DIST_MODE

  config BBQUE_AGENT_PROXY_DEFAULT_GRPC
    depends on BBQUE_AGENT_PROXY_GRPC
    bool "gRPC"

##NP

endchoice

config BBQUE_AGENT_PROXY_PORT_DEFAULT
  int "Server port"
  default 885
  ---help---
  The default port number for the AgentProxy server.

source barbeque/plugins/agent_proxy/grpc/Kconfig
```

## plugins/agent_proxy/grpc/Kconfig
```kconfig
config BBQUE_AGENT_PROXY_GRPC
  bool "gRPC"
  ---help---
  The AgentProxy plugin based on the gRPC library by Google Inc.
```

## plugins/ploader/Kconfig
```kconfig
choice
  depends on BBQUE_PIL_LOADER
  prompt "Default platform loader"
  default BBQUE_PIL_LOADER_DEFAULT_RXML
  config BBQUE_PIL_LOADER_DEFAULT_RXML
    bool "RXML"
    select BBQUE_PIL_LOADER_RXML
##NP

endchoice

source barbeque/plugins/ploader/rxml/Kconfig
```

## plugins/ploader/rxml/Kconfig
```kconfig
config BBQUE_PIL_LOADER_RXML
  depends on BBQUE_PIL_LOADER
  bool "RXML"
  default y
  select EXTERNAL_RAPIDXML
  ---help---
  Selection of the parser for the XML file of platform description.
```

## plugins/rloader/Kconfig
```kconfig
choice
  prompt "Default recipe loader"
  default BBQUE_RLOADER_DEFAULT_RXML
  config BBQUE_RLOADER_DEFAULT_XML
    bool "XML"
    select BBQUE_RLOADER_XML
  config BBQUE_RLOADER_DEFAULT_RXML
    bool "RXML"
    select BBQUE_RLOADER_RXML
##NP

endchoice

source barbeque/plugins/rloader/xml/Kconfig
source barbeque/plugins/rloader/rxml/Kconfig
```

## plugins/rloader/rxml/Kconfig
```kconfig
config BBQUE_RLOADER_RXML
  bool "RXML"
  default y
  select EXTERNAL_RAPIDXML
  ---help---
  Description...
```

## plugins/rloader/xml/Kconfig
```kconfig
config BBQUE_RLOADER_XML
  bool "XML"
  default n
  select EXTERNAL_TICPP
  ---help---
  XML Recipe loader based on library TiCPP (TinyXML for C++)
```

## plugins/schedpol/Kconfig
```kconfig
choice
  prompt "Default scheduling policy"
  config BBQUE_SCHEDPOL_DEFAULT_YAMS
    depends on BBQUE_SCHEDPOL_YAMS
    bool "YaMS"
  config BBQUE_SCHEDPOL_DEFAULT_YAMCA
    depends on BBQUE_SCHEDPOL_YAMCA
    bool "YaMCA"
  config BBQUE_SCHEDPOL_DEFAULT_RANDOM
    depends on BBQUE_SCHEDPOL_RANDOM
    bool "Random"
  config BBQUE_SCHEDPOL_DEFAULT_CLOVES
    depends on BBQUE_SCHEDPOL_CLOVES
    bool "Cloves"
  config BBQUE_SCHEDPOL_DEFAULT_TEMPURA
    depends on BBQUE_SCHEDPOL_TEMPURA
    bool "Tempura"
##NP

endchoice

source barbeque/plugins/schedpol/yams/Kconfig
#source barbeque/plugins/schedpol/yamca/Kconfig
source barbeque/plugins/schedpol/random/Kconfig
source barbeque/plugins/schedpol/cloves/Kconfig
source barbeque/plugins/schedpol/tempura/Kconfig
```

## plugins/schedpol/cloves/Kconfig
```kconfig
config BBQUE_SCHEDPOL_CLOVES
  bool "Cloves"
  depends on BBQUE_OPENCL
  depends on !BBQUE_TEST_PLATFORM_DATA
  select BBQUE_PM_AMD
  select BBQUE_PM_CPU
  default n
  ---help---
  Description...
```

## plugins/schedpol/gridbalance/Kconfig
```kconfig
config BBQUE_SCHEDPOL_GRIDBALANCE
  bool "GridBalance"
  default y
  ---help---
  Description...
```

## plugins/schedpol/manga/Kconfig
```kconfig
config BBQUE_SCHEDPOL_MANGA
  depends on TARGET_LINUX_MANGO
  bool "MangA"
  default n
  ---help---
  Description...
```

## plugins/schedpol/mangav2/Kconfig
```kconfig
config BBQUE_SCHEDPOL_MANGAV2
  bool "ManGAv2"
  depends on TARGET_LINUX_MANGO
  default n
  ---help---
  Description...
```

## plugins/schedpol/random/Kconfig
```kconfig
config BBQUE_SCHEDPOL_RANDOM
  bool "Random"
  default y
  ---help---
  Single binding domain (e.g. single multi-core CPU) resource allocation
  policy, featuring a random choice of AWM and resource binding.
```

## plugins/schedpol/scallop/Kconfig
```kconfig
config BBQUE_SCHEDPOL_SCALLOP
  bool "Scallop"
  default n
  ---help---
  Description...
```

## plugins/schedpol/tempura/Kconfig
```kconfig
config BBQUE_SCHEDPOL_TEMPURA
  bool "Tempura"
  default n
  select BBQUE_PM
  select BBQUE_PM_CPU
  ---help---
  Description...
```

## rtlib/bindings/Kconfig
```kconfig
config BBQUE_BINDINGS_PYTHON
  depends on TARGET_LINUX_NATIVE
  bool "Python wrapper"
  select EXTERNAL_PYBIND11
  default n
  ---help---
  Build the module to provide the Python wrapper of the RTLib
```
